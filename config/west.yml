## config/west.yml
```yaml
manifest:
  remotes:
    - name: zmkfirmware
      url-base: https://github.com/zmkfirmware

    - name: ergonautkb
      url-base: https://github.com/ergonautkb

    - name: caksoylar  # https://github.com/caksoylar/zmk-rgbled-widget
      url-base: https://github.com/caksoylar
    - name: urob
      url-base: https://github.com/urob

  projects:
    - name: zmk
      remote: zmkfirmware
      ###revision: v0.3 # Set to desired ZMK release
      revision: main # Set to desired ZMK release
      import: app/west.yml

    - name: ergonautkb-zmk-module
      remote: ergonautkb
      revision: main
    - name: zmk-rgbled-widget
      remote: caksoylar
      revision: main
    - name: zmk-helpers
      remote: urob
      revision: v0.3 # Should match ZMK release.

  self:
    path: config
```
